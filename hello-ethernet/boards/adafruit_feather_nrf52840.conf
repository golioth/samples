## hello-ethernet/boards/adafruit_feather_nrf52840.conf
```kconfig
CONFIG_SPI=y
CONFIG_NET_L2_ETHERNET=y
CONFIG_ETH_W5500=y
CONFIG_ETH_W5500_TIMEOUT=1000
CONFIG_NET_DHCPV4=y
CONFIG_NET_MGMT=y

# A programmer (J-Link or Nordic Dev Kit) is needed to program this board so
# this demo uses RTT for output instead of UART
CONFIG_UART_CONSOLE=n
CONFIG_RTT_CONSOLE=y
CONFIG_USE_SEGGER_RTT=y
```

## hello-ethernet/boards/nrf52840dk_nrf52840.conf
```kconfig
CONFIG_SPI=y
CONFIG_NET_L2_ETHERNET=y
CONFIG_ETH_W5500=y
CONFIG_ETH_W5500_TIMEOUT=1000
CONFIG_NET_DHCPV4=y
CONFIG_NET_MGMT=y
```

## hello-ethernet/sample.yaml
```yaml
sample:
  description: Say Hello to Golioth server via Ethernet
  name: hello-ethernet
common:
  harness: net
  platform_allow: >
    adafruit_feather_stm32f405
    nrf52840dk_nrf52840
    mimxrt1060_evk

  tags: golioth net socket
tests:
  sample.golioth.hello: {}
```

## sensors/bh1750/drivers/Kconfig
```kconfig
config BH1750
	bool "BH1750 Sensor"
	depends on I2C
	help
	  Enable driver for BH1750 sensors.
```

## weather-sensor/sample.yaml
```yaml
sample:
  description: Stream temperature, humidity, and pressure data to LightDB stream
  name: golioth-bme280
common:
  harness: net
  platform_allow: >
    circuitdojo_feather_nrf9160_ns
    esp32
  tags: golioth lightdb net socket
```
